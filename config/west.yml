## config/west.yml
```yaml
manifest:
  remotes:
    - name: zmkfirmware
      url-base: https://github.com/zmkfirmware
    - name: ftc
      url-base: https://github.com/ftc
    - name: petejohanson
      url-base: https://github.com/petejohanson
  projects:
    - name: zmk-mouse
      remote: ftc
      revision: mouse-ftc
      import: app/west.yml
    - name: zmk
      remote: petejohanson
      revision: shields/splitkb_aurora_sweep
      import: app/west.yml
  self:
    path: config
```
